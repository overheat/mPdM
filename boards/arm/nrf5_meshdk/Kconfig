## boards/arm/nrf5_meshdk/Kconfig
```kconfig
# Kconfig - nRF5 Mesh DK board configuration
#
# Copyright (c) 2016 Nordic Semiconductor ASA
#
# SPDX-License-Identifier: Apache-2.0

if BOARD_NRF5_MESHDK

config BOARD_ENABLE_DCDC
	bool "Enable DCDC mode"
	select SOC_DCDC_NRF52X
	default y

endif # BOARD_NRF5_MESHDK
```

## boards/arm/nrf5_meshdk/Kconfig.board
```kconfig
# Kconfig - nRF5 Mesh DK board configuration
#
# Copyright (c) 2016 Nordic Semiconductor ASA
#
# SPDX-License-Identifier: Apache-2.0

config  BOARD_NRF5_MESHDK
	bool "nRF5 Mesh DK"
	depends on SOC_NRF52832_QFAA
```

## boards/arm/nrf5_meshdk/Kconfig.defconfig
```kconfig
# Kconfig - nRF5 Mesh DK board configuration
#
# Copyright (c) 2016 Nordic Semiconductor ASA
#
# SPDX-License-Identifier: Apache-2.0

if BOARD_NRF5_MESHDK

config BOARD
	default "nrf5_meshdk"

if ADC

config ADC_0
	default y

endif # ADC

if I2C

config I2C_0
	default y

endif # I2C

if PWM

config PWM_0
	default y

endif # PWM

if SPI

config SPI_1
	default y

endif # SPI

config BT_CTLR
	default BT

endif # BOARD_NRF5_MESHDK
```
